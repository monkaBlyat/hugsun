// SPDX-License-Identifier: (GPL-2.0+ OR MIT)
/*
 * Copyright (c) 2021 Rockchip Electronics Co., Ltd.
 *
 */

/dts-v1/;

#include "rk3588-hugsun-edge-v10.dtsi"
#include "rk3588-android.dtsi"

/ {
	model = "Hugsun RK3588 EDGE LP4x V1.0 Android Board";
	compatible = "rockchip,rk3588-hugsun-edge-android", "rockchip,rk3588";
};

