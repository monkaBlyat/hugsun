// SPDX-License-Identifier: (GPL-2.0+ OR MIT)
/*
 * Copyright (c) 2021 Rockchip Electronics Co., Ltd.
 *
 */

/dts-v1/;

#include <dt-bindings/display/media-bus-format.h>
#include "rk3588s-hugsun-blueberry.dtsi"
#include "rk3588s-hugsun-blueberry-v10-mipi.dtsi"
#include "rk3588s-hugsun-blueberry-v10-camera.dtsi"
/ {
	model = "Rockchip RK3588S Blueberry V10 Board";
	compatible = "rockchip,rk3588s-Blueberry-v10", "rockchip,rk3588";
};
