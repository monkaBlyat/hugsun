// SPDX-License-Identifier: (GPL-2.0+ OR MIT)
/*
 * Copyright (c) 2021 Rockchip Electronics Co., Ltd.
 *
 */

/dts-v1/;

#include "rk3588-hugsun-ar.dtsi"
#include "rk3588-linux-ubuntu.dtsi"

/ {
	model = "Hugsun RK3588 ar V0.9 BlueBerry Board";
	compatible = "rockchip,rk3588-hugsun-ar-linux", "rockchip,rk3588";
};

