// SPDX-License-Identifier: (GPL-2.0+ OR MIT)
/*
 * Copyright (c) 2022 Rockchip Electronics Co., Ltd.
 *
 */

/dts-v1/;

#include "rk3588c-nvr-demo.dtsi"
#include "rk3588-linux.dtsi"
#include "rk3588-cpu-swap.dtsi"


/ {
	model = "Rockchip RK3588C NVR DEMO LP4 V10 Board";
	compatible = "rockchip,rk3588c-nvr-demo-v10", "rockchip,rk3588";
};
