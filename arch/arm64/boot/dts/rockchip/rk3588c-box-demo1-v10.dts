// SPDX-License-Identifier: (GPL-2.0+ OR MIT)
/*
 * Copyright (c) 2021 Rockchip Electronics Co., Ltd.
 *
 */

/dts-v1/;

#include "rk3588c-box-demo.dtsi"
#include "rk3588-android.dtsi"
#include "rk3588c-box-edp2dp.dtsi"
#include "rk3588c-box-hdmi2bt1120.dtsi"

/ {
	model = "Rockchip RK3588C BOX DEMO1 LP4 V10 Board";
	compatible = "rockchip,rk3588c-box-demo1-v10", "rockchip,rk3588";
};

